## .github/workflows/scripts/oplus_patch/Kconfig
```kconfig
# SPDX-License-Identifier: GPL-2.0-only
# Copyright (C) 2023-2030 Oplus. All rights reserved.
# Vendored from OnePlusOSS/android_kernel_modules_and_devicetree_oneplus_sm8850
# branch oneplus/sm8850_b_16.0.0_oneplus_15, path vendor/oplus/kernel/patch/Kconfig.
# Verbatim. Wired into the tree via drivers/{Kconfig,Makefile} by
# KernelBuilder.apply_oplus_patch().

config OPLUS_PATCH
    tristate "Oplus Kernel Patch"
    default n
    help
      This option enables support for Oplus Kernel Patch.
```

## .github/workflows/scripts/oplus_storage_log/Kconfig
```kconfig
# Vendored from OnePlusOSS/android_kernel_modules_and_devicetree_oneplus_sm8850
# branch oneplus/sm8850_b_16.0.0_oneplus_15, path
# vendor/oplus/kernel/storage/storage_feature_in_module/common/storage_log/Kconfig.
# Verbatim. Provides pr_storage() for oplus_uprobe.

config OPLUS_FEATURE_STORAGE_LOG
   tristate "config storage log"
   default n
   help
     General Configuration of Storage Log
```

## .github/workflows/scripts/oplus_waker_identify/Kconfig
```kconfig
# SPDX-License-Identifier: GPL-2.0-only
# Copyright (C) 2023-2030 Oplus. All rights reserved.
# Vendored from OnePlusOSS/android_kernel_modules_and_devicetree_oneplus_sm8550
# branch oneplus/sm8550_v_15.0.0_oneplus11, path vendor/oplus/kernel/cpu/waker_identify/Kconfig.
# Verbatim (incl. the "identifyKconfig" help typo). Wired into the tree via
# drivers/{Kconfig,Makefile} by KernelBuilder.apply_oplus_waker() (upstream
# places it under kernel/sched/).

config OPLUS_FEATURE_WAKER_IDENTIFY
    tristate "oplus waker identify"
    default n
    help
      oplus waker identify
```
